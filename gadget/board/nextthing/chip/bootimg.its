## gadget/board/nextthing/chip/bootimg.its
```
/dts-v1/;
/ {
	description = "CHIP Kernel, Ramdisk, FDT";
	#address-cells = <1>;
	images {
		kernel@1 {
			description = "chip_4.4";
			data = /incbin/("../../../output/images/zImage");
			type = "kernel";
			arch = "arm";
			os = "linux";
			compression = "gzip";
			load = <4200000>;
			entry = <00000000>;
			hash@1 {
				algo = "md5";
			};
			hash@2 {
				algo = "sha1";
			};
		};
		ramdisk@1 {
			description = "buildroot_hash";
			data = /incbin/("../../../output/images/rootfs.cpio.gz");
			type = "ramdisk";
			arch = "arm";
			os = "linux";
			compression = "gzip";
			load = <4400000>;
			entry = <00000000>;
			hash@1 {
				algo = "sha1";
			};
		};
		fdt@1 {
			description = "";
			data = /incbin/("../../../output/images/sun5i-r8-chip.dtb");
			type = "flat_dt";
			arch = "arm";
			compression = "none";
			load = <4300000>;
			entry = <00000000>;
			hash@1 {
				algo = "crc32";
			};
		};
	};
	configurations {
		default = "config@1";
		config@1 {
			description = "boot configuration";
			kernel = "kernel@1";
			ramdisk = "ramdisk@1";
			fdt = "fdt@1";
		};
	};
};
```

## gadget/package/rtl8723ds_bt/Config.in
```kconfig
config BR2_PACKAGE_RTL8723DS_BT
	bool "rtl8723ds_bt"
	help
	  Firmware and config for the rtl8723ds_bt SDIO Bluetooth module.

	  Make sure your target kernel has the following config
	  options enabled:

	    * CONFIG_BT: bluetooth support
		* CONFIG_BT_HCIUART: bluetooth HCI UART serial driver

if BR2_PACKAGE_RTL8723DS_BT

config BR2_PACKAGE_RTL8723DS_BT_RST_PIN
prompt "Reset Pin"
int
default 36

config BR2_PACKAGE_RTL8723DS_BT_TTY_DEV
prompt "Terminal Device"
string
default /dev/ttyS2

config BR2_PACAKGE_RTL8723DS_BT_CONFIG
prompt "Firmware Configuration File"
string
default rtl8723d_config

endif
```
